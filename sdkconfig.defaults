## sdkconfig.defaults
```kconfig
# Logging / timer / ROM prints out of IRAM
CONFIG_LOG_IN_IRAM=n
CONFIG_ESP_TIMER_IN_IRAM=n
CONFIG_ESP_ROM_PRINT_IN_IRAM=n

# Power-management helpers out of IRAM
CONFIG_PM_SLEEP_FUNC_IN_IRAM=n
CONFIG_PM_SLP_IRAM_OPT=n

# Interrupt stubs out of IRAM
CONFIG_ESP_INTR_IN_IRAM=n

# Periph control helpers out of IRAM
CONFIG_ESP_PERIPH_CTRL_FUNC_IN_IRAM=n
CONFIG_ESP_REGI2C_CTRL_FUNC_IN_IRAM=n

# Drivers that default to IRAM
CONFIG_RMT_ENCODER_FUNC_IN_IRAM=n
CONFIG_GPTIMER_ISR_HANDLER_IN_IRAM=n
CONFIG_SPI_MASTER_ISR_IN_IRAM=n
CONFIG_SPI_SLAVE_ISR_IN_IRAM=n
CONFIG_I2C_MASTER_ISR_HANDLER_IN_IRAM=n
CONFIG_MCPWM_ISR_HANDLER_IN_IRAM=n

# FreeRTOS/port not in IRAM
CONFIG_FREERTOS_IN_IRAM=n

# GDB stub uses IRAM; disable it
CONFIG_ESP_GDBSTUB_ENABLED=n

# Wi-Fi IRAM opts (you already disabled extras; keep these OFF)
CONFIG_ESP_WIFI_IRAM_OPT=n
CONFIG_ESP_WIFI_RX_IRAM_OPT=n
CONFIG_ESP_WIFI_EXTRA_IRAM_OPT=n
CONFIG_ESP_WIFI_SLP_IRAM_OPT=n

# SPI flash functions in flash, not IRAM
CONFIG_SPI_FLASH_PLACE_FUNCTIONS_IN_IRAM=n
```
